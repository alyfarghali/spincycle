## firmware/components/sensing/Kconfig.projbuild
```kconfig
menu "SpinCycle sensor"

    config SPINCYCLE_I2C_SDA_GPIO
        int "Accelerometer I2C SDA GPIO"
        default 6
        help
            Must match hardware/wiring.md.

    config SPINCYCLE_I2C_SCL_GPIO
        int "Accelerometer I2C SCL GPIO"
        default 7
        help
            Must match hardware/wiring.md.

    config SPINCYCLE_ACCEL_I2C_ADDR
        hex "ICM-20948 I2C address"
        default 0x69
        help
            0x69 on the SparkFun breakout by default; 0x68 if the ADR jumper is bridged.

    config SPINCYCLE_FAKE_ACCEL
        bool "Fake accelerometer (no sensor attached)"
        default n
        help
            Replace the ICM-20948 driver with synthetic samples: gravity, noise, and a shake
            that switches on and off on a fixed cycle. For testing Wi-Fi, MQTT and the backend
            without hardware. Never use it for recordings in testdata/cycles/.

    config SPINCYCLE_FAKE_IDLE_S
        int "Fake: idle seconds per cycle"
        depends on SPINCYCLE_FAKE_ACCEL
        range 1 86400
        default 120

    config SPINCYCLE_FAKE_RUN_S
        int "Fake: running seconds per cycle"
        depends on SPINCYCLE_FAKE_ACCEL
        range 1 86400
        default 360

endmenu
```

## firmware/test_app/sdkconfig.defaults
```kconfig
CONFIG_IDF_TARGET="esp32c6"
CONFIG_MBEDTLS_CERTIFICATE_BUNDLE=y
CONFIG_PARTITION_TABLE_SINGLE_APP_LARGE=y
```
